/* USER CODE BEGIN Header */
/**
 ******************************************************************************
 * File Name          : app_freertos.h
 * Description        : FreeRTOS applicative header file
 ******************************************************************************
 * @attention
 *
 * Copyright (c) 2024 STMicroelectronics.
 * All rights reserved.
 *
 * This software is licensed under terms that can be found in the LICENSE file
 * in the root directory of this software component.
 * If no LICENSE file comes with this software, it is provided AS-IS.
 *
 ******************************************************************************
 */
/* USER CODE END Header */

/* Define to prevent recursive inclusion -------------------------------------*/
#ifndef __APP_FREERTOS_H__
#define __APP_FREERTOS_H__

#ifdef __cplusplus
extern "C" {
#endif
/* Includes ------------------------------------------------------------------*/

/* Private includes ----------------------------------------------------------*/
/* USER CODE BEGIN Includes */
#include "sensor_context.h"
#include <stdbool.h>

/* USER CODE END Includes */

/* Exported types ------------------------------------------------------------*/
/* USER CODE BEGIN ET */
typedef enum eEventType_t
{
  eEventFirst = 0,
  eEventTimer,
  eEventTilt,
  eEventMLC1,         // event generated by INT1 (MLC1_SRC) added
  eEventFSM,          // event generated by INT2 (FSM_OUTS) added
  EVENT_TYPE_COUNT    // helper value to keep track of the number of event types
} eEventType_t;

typedef struct HumidityAndTemperature
{
  float hum;
  float temp;
} HumidityAndTemperature;

typedef struct AccelerometerData
{
  float x;
  float y;
  float z;
} AccelerometerData;

typedef struct BarometerData
{
  float pres;
} BarometerData;

typedef struct SensorsData
{
  HumidityAndTemperature sensor_hum_and_temp;
  AccelerometerData sensor_accelerometer;
  BarometerData sensor_barometer;
  eEventType_t event_type;
  uint32_t mlc_output;  // field to store MLC output value out of 4 possible states (00, 04, 08, 0C)
  bool fsm_impact;      // field to store FSM output value
  bool fsm_free_fall;   // added field to store FSM output value
} SensorsData;

typedef enum Sensors_Init_State
{
  SensorsNotYetInitialized = 0,
  SensorAccInitDone = 1,
  SensorBarInitDone = 2,
  SensorHtInitDone = 4,
  SensorsInitialized = SensorAccInitDone | SensorBarInitDone | SensorHtInitDone
} Sensors_Init_State;

/* USER CODE END ET */

/* Exported constants --------------------------------------------------------*/
/* USER CODE BEGIN EC */

/* USER CODE END EC */

/* Private define ------------------------------------------------------------*/
/* USER CODE BEGIN PD */

/* USER CODE END PD */

/* Exported macro -------------------------------------------------------------*/
/* USER CODE BEGIN EM */

/* USER CODE END EM */

/* Exported function prototypes -----------------------------------------------*/
/* USER CODE BEGIN FunctionPrototypes */
extern volatile Sensors_Init_State sensors_init_state;

void SensorsDataTask(void *pvParameters);

bool EventBuffer_IsEmpty(void);
bool EventBuffer_IsFull(void);
bool EventBuffer_Push(const SensorsData *pData);
bool EventBuffer_Pop(SensorsData *pData);
void PrintEventBufferContents();

uint16_t EventBuffer_Count(void);

/* USER CODE END FunctionPrototypes */

#ifdef __cplusplus
}
#endif
#endif /* __APP_FREERTOS_H__ */
